## config/paseo-leds/Kconfig
```kconfig
# Paseo LEDs -- Phase 2 firmware spike (per-key RGB over BLE, number row)
# SPDX-License-Identifier: MIT

config PASEO_LEDS
    bool "Paseo per-key BLE LED control for the number row (spike)"
    default y
    select ZMK_RGB_UNDERGLOW
    help
      Adds a custom BLE GATT service (central/left half only) that lets a
      host push per-key RGB values for the number row (1-5 on the left
      half, 6-0 on the right half) over the existing wireless split link,
      writing straight to the WS2812 strip. Research spike, not a real
      feature: no persistence, no animation, last-frame-wins.
```

## config/paseo-leds/dts/bindings/behaviors/paseo,leds-invoke.yaml
```yaml
# Paseo LEDs -- Phase 2 firmware spike (per-key RGB over BLE, number row)
# SPDX-License-Identifier: MIT

description: |
  Global-locality behavior used internally by the paseo-leds GATT write
  handler (central/left half) to push right-half pixel updates to the
  peripheral over the split link. Not meant to be bound in a keymap layer.
  param1/param2 each pack one pixel as index<<24 | r<<16 | g<<8 | b; param2
  may be the sentinel 0xFFFFFFFF meaning "no second pixel this call". The
  index byte may also be 0xFD, the host microphone-state sentinel, or 0xFE,
  the fill-all sentinel. The peripheral applies either control operation
  without consulting the logical key maps (see paseo_leds.c).

compatible: "paseo,leds-invoke"

include: two_param.yaml
```

## config/paseo-leds/dts/bindings/behaviors/paseo,leds-mic.yaml
```yaml
# SPDX-License-Identifier: MIT

description: Global microphone-state LED overlay for the right thumb key.

compatible: "paseo,leds-mic"

include: zero_param.yaml
```

## config/paseo-leds/dts/bindings/behaviors/paseo,leds-toggle.yaml
```yaml
# Paseo LEDs -- Phase 2 firmware spike (per-key RGB over BLE, number row)
# SPDX-License-Identifier: MIT

description: |
  Global-locality Paseo-mode toggle. Bound directly in the keymap (&plt) so
  pressing it on either half flips the paseo_leds_enabled flag on BOTH
  halves in lockstep. Frame/behavior-invocation pixel writes always keep
  updating each half's pixel buffer; only the led_strip flush is gated on
  this flag. Disabling blanks the strip once (writes off pixels straight
  to the strip, buffer untouched); re-enabling flushes the stored buffer
  immediately. See paseo_leds_toggle.c / paseo_leds.c.

compatible: "paseo,leds-toggle"

include: zero_param.yaml
```

## config/paseo-leds/dts/bindings/paseo,leds.yaml
```yaml
# Paseo LEDs -- Phase 2 firmware spike (per-key RGB over BLE, number row)
# SPDX-License-Identifier: MIT

description: |
  Paseo per-key BLE LED spike: WS2812 strip-index lookup tables for the
  number row and the home-row action keys, one entry per logical key.
  Logical index 0-4 = left-half keys 1-5, logical index 5-9 (array index
  0-4 in right-number-row-indices) = right-half keys 6,7,8,9,0, logical
  index 10-15 (array index 0-5 in right-extra-indices, order Y U J K L
  SEMI) = right-half home-row action keys, logical indices 16-17 (the two
  entries in left-extra-indices) = left-half F and D. Index 0xFE in a frame/
  behavior-invocation pixel entry is not a logical index at all -- it's
  the fill-all sentinel (see paseo_leds.c) and doesn't consult either
  table.

  left-number-row-indices is derived directly from the commented physical
  layout on go60_lh.dts's `underglow_indicators` node (row 0 = top row):
  N1=22 N2=17 N3=12 N4=7 N5=3.

  right-number-row-indices has NO equivalent documented source (go60_rh.dts
  ships no underglow-indicators node at all) -- it's a best-effort mirror
  of the left-half zig-zag wiring pattern by column position, NOT verified
  on hardware. Kept as a devicetree property (rather than hardcoded in C)
  specifically so it's a one-line fix here after on-hardware testing.

  left-extra-indices / right-extra-indices extend the same lookup to F/D
  (left) and Y, U, J, K, L, SEMI (right) -- see paseo_leds.c for the full
  column-arithmetic derivation. left-extra-indices is read directly off
  the same hardware-verified left-half grid as left-number-row-indices
  (same certainty). right-extra-indices carries the same not-verified-on-
  hardware caveat as right-number-row-indices: it's the same column-
  mirroring assumption applied one row down, not an independent guess.

compatible: "paseo,leds"

properties:
  left-number-row-indices:
    type: array
    required: true
  right-number-row-indices:
    type: array
    required: true
  left-extra-indices:
    type: array
    required: true
  right-extra-indices:
    type: array
    required: true
  right-mic-index:
    type: int
    required: true
    description: Right strip index for the inner push-to-talk thumb key.
```
